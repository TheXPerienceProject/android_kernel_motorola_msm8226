## arch/arm/hotplug/Kconfig
```kconfig
config ALESSA_PLUG
	bool "Enable plugging down/up of cores using powersuspend"
	help
	  This driver uses powersuspend to take down the cpu cores
	  on a dual core device.
	  Later this maybe be a reemplace of hotplug.

config INTELLI_PLUG
        bool "Enable intelli-plug cpu hotplug driver"
        default n
        help
          Generic Intelli-plug cpu hotplug driver for ARM SOCs
```
